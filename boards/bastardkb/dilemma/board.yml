## boards/bastardkb/dilemma/board.yml
```yaml
boards:
  - name: dilemma_left
    full_name: BastardKB Dilemma Left
    vendor: bastardkb
    socs:
      - name: rp2040
  - name: dilemma_right
    full_name: BastardKB Dilemma Right
    vendor: bastardkb
    socs:
      - name: rp2040
```

## config/west.yml
```yaml
manifest:
  remotes:
    - name: zmkfirmware
      url-base: https://github.com/zmkfirmware
  projects:
    - name: zmk
      remote: zmkfirmware
      revision: main
      import: app/west.yml
    - name: zmk-behaviors-dev
      remote: paulshir
      revision: main
  self:
    path: config
```
